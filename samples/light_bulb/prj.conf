## CMakeLists.txt
```
#
# Copyright (c) 2024 Nordic Semiconductor ASA
#
# SPDX-License-Identifier: LicenseRef-Nordic-5-Clause
#

cmake_minimum_required(VERSION 3.20.0)

find_package(Zephyr REQUIRED HINTS $ENV{ZEPHYR_BASE})

project("Zigbee + Matter Light Bulb with FOTA")

# Check if Matter is enabled
if(CONFIG_CHIP)
    # Enable GNU STD support for Matter
    include(${ZEPHYR_CONNECTEDHOMEIP_MODULE_DIR}/config/nrfconnect/app/enable-gnu-std.cmake)

    # Include all source files that are located in the Matter common directory.
    include(${ZEPHYR_NRF_MODULE_DIR}/samples/matter/common/cmake/source_common.cmake)

    # Include Data Model utils (simplified for Zigbee coexistence)
    include(${ZEPHYR_NRF_MODULE_DIR}/samples/matter/common/cmake/data_model.cmake)
    
    include(${ZEPHYR_NRF_MODULE_DIR}/samples/matter/common/cmake/zap_helpers.cmake)
    ncs_get_zap_parent_dir(ZAP_PARENT_DIR)
    
    target_include_directories(app PRIVATE
        src
        include
        ${ZAP_PARENT_DIR}
    )
    
    target_compile_options(app PRIVATE -Wno-deprecated-declarations)
    
    # NORDIC SDK APP START
    target_sources(app PRIVATE
        src/main.cpp
        src/app_task_zigbee.cpp
        src/app_task_matter.cpp
        src/zboss_mem_globals.c
        ${CHIP_ROOT}/src/app/persistence/DeferredAttributePersistenceProvider.cpp
    )
    
    ncs_configure_data_model()
    # NORDIC SDK APP END
else()
    # Zigbee-only build
    target_sources(app PRIVATE
        src/main.cpp
        src/app_task_zigbee.cpp
        src/zboss_mem_globals.c
    )
    
    target_include_directories(app PRIVATE include)
endif()

# LTO link: zb_memconfig.o from prebuilts is plain ELF (weak gc_*); strong gc_*
# in zb_mem_config_context.h must not be LTO bytecode or ld warns about symbol size.
if(CONFIG_LTO)
	set_source_files_properties(
		src/zboss_mem_globals.c
		PROPERTIES COMPILE_OPTIONS -fno-lto
	)
endif()
```

## sample.yaml
```
sample:
  description: Zigbee Light control - light bulb sample
  name: Zigbee Light control
common:
  tags:
    - ci_build
    - smoke
    - sysbuild
    - ci_samples_zigbee
tests:
  sample.zigbee.light_bulb:
    sysbuild: true
    build_only: true
    integration_platforms:
      - nrf52840dk/nrf52840
      - nrf5340dk/nrf5340/cpuapp
      - nrf54l15dk/nrf54l15/cpuapp
      - nrf54lm20dk/nrf54lm20b/cpuapp
    platform_allow:
      - nrf52840dk/nrf52840
      - nrf5340dk/nrf5340/cpuapp
      - nrf54l15dk/nrf54l10/cpuapp
      - nrf54l15dk/nrf54l15/cpuapp
      - nrf54lc10dk/nrf54lc10a/cpuapp
      - nrf54lm20dk/nrf54lm20a/cpuapp
      - nrf54lm20dk/nrf54lm20b/cpuapp
  sample.zigbee.light_bulb.fota_and_bt_dfu:
    sysbuild: true
    build_only: true
    extra_args:
      - FILE_SUFFIX=fota
      - SNIPPET=zigbee_fota_ext_flash
      - CONFIG_ZIGBEE_BT_DFU=y
    integration_platforms:
      - nrf54lm20dk/nrf54lm20b/cpuapp
    platform_allow:
      - nrf54lm20dk/nrf54lm20a/cpuapp
      - nrf54lm20dk/nrf54lm20b/cpuapp
  sample.zigbee.light_bulb.with_shell:
    sysbuild: true
    build_only: true
    extra_args:
      - CONFIG_ZIGBEE_SHELL=y
      - CONFIG_ZIGBEE_SHELL_DEBUG_CMD=y
      - CONFIG_ZIGBEE_LOGGER_EP=n
      - CONFIG_ZIGBEE_SHELL_ENDPOINT=10
      - CONFIG_LOG_MODE_DEFERRED=y
      - CONFIG_ZIGBEE_TOUCHLINK_TARGET=y
    platform_allow:
      - nrf52840dk/nrf52840
      - nrf5340dk/nrf5340/cpuapp
      - nrf54l15dk/nrf54l10/cpuapp
      - nrf54l15dk/nrf54l15/cpuapp
      - nrf54lc10dk/nrf54lc10a/cpuapp
      - nrf54lm20dk/nrf54lm20a/cpuapp
      - nrf54lm20dk/nrf54lm20b/cpuapp
    tags:
      - no_integration
      - shell
```

## prj.conf
```kconfig
#
# Copyright (c) 2024 Nordic Semiconductor ASA
#
# SPDX-License-Identifier: LicenseRef-Nordic-5-Clause
#

CONFIG_NCS_APPLICATION_BOOT_BANNER_STRING="Zigbee R23 Light Bulb"

CONFIG_NCS_SAMPLES_DEFAULTS=y

CONFIG_UART_INTERRUPT_DRIVEN=y
CONFIG_SERIAL=y
CONFIG_GPIO=y
CONFIG_PWM=y

# Make sure printk is not printing to the UART console
CONFIG_CONSOLE=y
CONFIG_UART_CONSOLE=y

CONFIG_HEAP_MEM_POOL_SIZE=2048
CONFIG_MAIN_THREAD_PRIORITY=7

CONFIG_ZIGBEE_ADD_ON=y
CONFIG_ZIGBEE_APP_UTILS=y
CONFIG_ZIGBEE_ROLE_ROUTER=y

# Enable DK LED and Buttons library
CONFIG_DK_LIBRARY=y

CONFIG_ZBOSS_DEFAULT_THREAD_STACK_SIZE=3328
CONFIG_MAIN_STACK_SIZE=1280
# This example requires more workqueue stack
CONFIG_SYSTEM_WORKQUEUE_STACK_SIZE=2048

# Scene extension
CONFIG_ZIGBEE_SCENES=y
```

## prj_fota.conf
```kconfig
#
# Copyright (c) 2026 Nordic Semiconductor ASA
#
# SPDX-License-Identifier: LicenseRef-Nordic-5-Clause
#

CONFIG_NCS_SAMPLES_DEFAULTS=y

CONFIG_UART_INTERRUPT_DRIVEN=y
CONFIG_SERIAL=y
CONFIG_GPIO=y
CONFIG_PWM=y

CONFIG_CONSOLE=y
CONFIG_UART_CONSOLE=y

CONFIG_HEAP_MEM_POOL_SIZE=2048
CONFIG_MAIN_THREAD_PRIORITY=7

CONFIG_ZIGBEE_ADD_ON=y
CONFIG_ZIGBEE_APP_UTILS=y
CONFIG_ZIGBEE_ROLE_ROUTER=y

CONFIG_DK_LIBRARY=y

CONFIG_ZBOSS_DEFAULT_THREAD_STACK_SIZE=3328
CONFIG_MAIN_STACK_SIZE=1280
CONFIG_SYSTEM_WORKQUEUE_STACK_SIZE=2048

CONFIG_ZIGBEE_SCENES=y

#######################
# Zigbee FOTA overlay #
#######################

CONFIG_ZIGBEE_FOTA=y
CONFIG_ZIGBEE_FOTA_HW_VERSION=52
CONFIG_ZIGBEE_FOTA_ENDPOINT=11
CONFIG_MCUBOOT_IMGTOOL_SIGN_VERSION="1.0.0"
CONFIG_ZIGBEE_FOTA_COMMENT="light_bulb"
CONFIG_ZIGBEE_FOTA_DOWNLOAD_RESUME=y

CONFIG_IMG_MANAGER=y
CONFIG_STREAM_FLASH=y
CONFIG_DFU_TARGET_MCUBOOT=y
CONFIG_IMG_ERASE_PROGRESSIVELY=y
CONFIG_ZIGBEE_FOTA_PROGRESS_EVT=y

CONFIG_NRF_802154_RX_BUFFERS=32
```

## prj_matter_fota.conf
```kconfig
#
# Copyright (c) 2026 Nordic Semiconductor ASA
#
# SPDX-License-Identifier: LicenseRef-Nordic-5-Clause
#
# Debug configuration for combined Zigbee + Matter + Thread (PoC)
# Includes logging, console, and debug features

# Base sample configs
CONFIG_NCS_SAMPLES_DEFAULTS=y

CONFIG_UART_INTERRUPT_DRIVEN=y
CONFIG_SERIAL=y
CONFIG_GPIO=y
CONFIG_PWM=y

# Console
CONFIG_CONSOLE=y
CONFIG_UART_CONSOLE=y

# CONFIG_HEAP_MEM_POOL_SIZE=4096
CONFIG_MAIN_THREAD_PRIORITY=7

#######################
# Zigbee Configuration
#######################

CONFIG_ZIGBEE_ADD_ON=y
CONFIG_ZIGBEE_APP_UTILS=y
# Show Zigbee init/recovery logs (Device first start, network steering recovery).
CONFIG_ZIGBEE_APP_UTILS_LOG_LEVEL_INF=y
CONFIG_ZIGBEE_ROLE_ROUTER=y

# Touchlink target role for the combined Matter build
CONFIG_ZIGBEE_TOUCHLINK_TARGET=y

# Scene extension
CONFIG_ZIGBEE_SCENES=y

# Enable DK LED and Buttons library
CONFIG_DK_LIBRARY=y

# This example requires more workqueue stack
CONFIG_SYSTEM_WORKQUEUE_STACK_SIZE=2048

CONFIG_ZBOSS_OSIF_LOG_LEVEL_INF=y
CONFIG_ZIGBEE_MATTER_COEXISTENCE_LOG_LEVEL_INF=y

#######################
# Zigbee FOTA Configuration
#######################

# FIXME: Disabled Zigbee FOTA for initial development
# # Enable Zigbee FOTA library
# CONFIG_ZIGBEE_FOTA=y
# CONFIG_ZIGBEE_FOTA_HW_VERSION=52
# CONFIG_ZIGBEE_FOTA_ENDPOINT=5
# CONFIG_MCUBOOT_IMGTOOL_SIGN_VERSION="1.0.0"
# CONFIG_ZIGBEE_FOTA_COMMENT="light_bulb_matter"

# # Ensure an MCUboot-compatible binary is generated.
# CONFIG_IMG_MANAGER=y
# CONFIG_STREAM_FLASH=y
# CONFIG_DFU_TARGET_MCUBOOT=y
# CONFIG_IMG_ERASE_PROGRESSIVELY=y
# CONFIG_ZIGBEE_FOTA_PROGRESS_EVT=y

# # Increase the number of RX buffers for FOTA
# CONFIG_NRF_802154_RX_BUFFERS=32

#######################
# Matter Configuration
#######################

# Enable CHIP (Matter)
CONFIG_CHIP=y
CONFIG_CHIP_PROJECT_CONFIG="include/chip_project_config.h"
CONFIG_CHIP_DEVICE_PRODUCT_NAME="Matter Zigbee Light Bulb"

# Configure ZAP file
CONFIG_NCS_SAMPLE_MATTER_ZAP_FILE_PATH="${APPLICATION_CONFIG_DIR}/src/matter_zap/light_bulb.zap"

# 32773 == 0x8005 (example lighting-app)
CONFIG_CHIP_DEVICE_PRODUCT_ID=32773
CONFIG_STD_CPP17=y

# Enable Matter pairing automatically on application start.
CONFIG_CHIP_ENABLE_PAIRING_AUTOSTART=y

# Enable Matter extended announcement and increase duration to 1 hour.
CONFIG_CHIP_BLE_EXT_ADVERTISING=y
CONFIG_CHIP_BLE_ADVERTISING_DURATION=60

CONFIG_BT_DEVICE_NAME="MatterZigbee"

# Other settings
CONFIG_THREAD_NAME=y
CONFIG_MPU_STACK_GUARD=y
CONFIG_RESET_ON_FATAL_ERROR=n

# Reduce application size
CONFIG_USE_SEGGER_RTT=n

# Increase system workqueue stack for combined protocols (with Thread)
CONFIG_SYSTEM_WORKQUEUE_STACK_SIZE=6144

# Must be a preemptible priority (0–15), not cooperative (-1). With -1, ZBOSS is
# coop priority -1 and is outranked by MPSL Work (prio -8), so it never runs.
# State 128 = _THREAD_QUEUED (runnable); ZBOSS stays queued and never gets CPU.
CONFIG_ZBOSS_DEFAULT_THREAD_PRIORITY=1
CONFIG_ZBOSS_DEFAULT_THREAD_STACK_SIZE=6144

# Libc malloc arena required for Zigbee + Matter coexistence.
# - 0: no libc heap -> Matter init fails (malloc/calloc used during init).
# - -1: "all remaining RAM" -> on this build the computed heap extends past
#   valid RAM and triggers a precise data bus fault in sys_heap_init().
# - Positive value: static BSS heap of that size -> valid heap, no fault.
# Matter uses CHIP_MALLOC_SYS_HEAP for its own allocations; this arena
# covers libc malloc() used elsewhere (init, Zephyr, Zigbee, etc.).
CONFIG_COMMON_LIBC_MALLOC_ARENA_SIZE=-1

## PoC Configuration ##
# Keep Matter shell disabled to avoid getopt conflicts
CONFIG_CHIP_LIB_SHELL=n
CONFIG_NCS_SAMPLE_MATTER_TEST_SHELL=n

# Radio dispatcher 
CONFIG_NRF_802154_CALLBACKS_DISPATCHER=y

# We need it to disable ZBOSS thread
CONFIG_ZIGBEE_DEBUG_FUNCTIONS=y

CONFIG_CHIP_FACTORY_DATA_BUILD=y
```

## src/main.cpp
```c
/*
 * Copyright (c) 2024-2026 Nordic Semiconductor ASA
 *
 * SPDX-License-Identifier: LicenseRef-Nordic-5-Clause
 */

/** @file
 *
 * @brief Matter + Zigbee light bulb entry point.
 */

#include "app_task_zigbee.h"

#ifdef CONFIG_CHIP

#include "app_task_matter.h"

#include <zigbee/matter_coexistence.h>

#include <zephyr/logging/log.h>

LOG_MODULE_REGISTER(app, CONFIG_CHIP_APP_LOG_LEVEL);

namespace
{

void matter_start_cb(void)
{
	AppTask::Instance().StartApp();
}

const struct zigbee_matter_coexistence_callbacks coexistence_cb = {
	matter_start_cb,
	ZigbeeStart,
	zb_register_button_handler,
};

} /* namespace */

#endif /* CONFIG_CHIP */

int main(void)
{
#ifdef CONFIG_CHIP
	return zigbee_matter_coexistence_run(&coexistence_cb);
#else
	return ZigbeeStart();
#endif
}
```

## src/app_task_zigbee.cpp
```c
/*
 * Copyright (c) 2026 Nordic Semiconductor ASA
 *
 * SPDX-License-Identifier: LicenseRef-Nordic-5-Clause
 */

/** @file
 *
 * @brief Simple Zigbee light bulb implementation.
 */

#include "app_task_zigbee.h"

#ifdef CONFIG_ZIGBEE_MATTER_COEXISTENCE
#include <zigbee/matter_coexistence.h>
#include <zigbee/matter_protocol_state.h>
#endif

#include <soc.h>
#include <zephyr/device.h>
#include <zephyr/drivers/pwm.h>
#include <zephyr/kernel.h>
#include <zephyr/logging/log.h>
#include <zephyr/sys/util.h>
#ifdef CONFIG_ZIGBEE_SCENES
#include <zephyr/settings/settings.h>
#endif
#include <zephyr/types.h>

extern "C" {
#include "zb_dimmable_light.h"
#include <dk_buttons_and_leds.h>
#include <zb_nrf_platform.h>
#include <zboss_api.h>
#include <zboss_api_addons.h>
#include <zigbee/zigbee_app_utils.h>
#include <zigbee/zigbee_error_handler.h>
#ifdef CONFIG_ZIGBEE_SCENES
#include <zigbee/zigbee_zcl_scenes.h>
#endif
}

#define RUN_STATUS_LED DK_LED1
#define RUN_LED_BLINK_INTERVAL 1000

/* Device endpoint, used to receive light controlling commands. */
#define DIMMABLE_LIGHT_ENDPOINT 10

/* Version of the application software (1 byte). */
#define BULB_INIT_BASIC_APP_VERSION 01

/* Version of the implementation of the Zigbee stack (1 byte). */
#define BULB_INIT_BASIC_STACK_VERSION 10

/* Version of the hardware of the device (1 byte). */
#define BULB_INIT_BASIC_HW_VERSION 11

/* Manufacturer name (32 bytes). */
#define BULB_INIT_BASIC_MANUF_NAME "Nordic"

/* Model number assigned by manufacturer (32-bytes long string). */
#define BULB_INIT_BASIC_MODEL_ID "Dimable_Light_v0.1"

/* First 8 bytes specify the date of manufacturer of the device
 * in ISO 8601 format (YYYYMMDD). The rest (8 bytes) are manufacturer specific.
 */
#define BULB_INIT_BASIC_DATE_CODE "20200329"

/* Type of power sources available for the device.
 * For possible values see section 3.2.2.2.8 of ZCL specification.
 */
#define BULB_INIT_BASIC_POWER_SOURCE ZB_ZCL_BASIC_POWER_SOURCE_DC_SOURCE

/* Describes the physical location of the device (16 bytes).
 * May be modified during commissioning process.
 */
#define BULB_INIT_BASIC_LOCATION_DESC "Office desk"

/* Describes the type of physical environment.
 * For possible values see section 3.2.2.2.10 of ZCL specification.
 */
#define BULB_INIT_BASIC_PH_ENV ZB_ZCL_BASIC_ENV_UNSPECIFIED

/* LED indicating that light switch successfully joind Zigbee network. */
#define ZIGBEE_NETWORK_STATE_LED DK_LED3

/* LED immitaing dimmable light bulb - define for informational
 * purposes only.
 */
#define BULB_LED DK_LED4

#if defined(CONFIG_ZIGBEE_MATTER_COEXISTENCE_BUTTON_SWITCH)
/* Long-press to switch active protocol. */
#define PROTOCOL_SWITCH_BUTTON DK_BTN3_MSK
#endif

/* Button used to enter the Bulb into the Identify mode. */
#define IDENTIFY_MODE_BUTTON DK_BTN4_MSK

/* Use onboard led4 to act as a light bulb.
 * The app.overlay file has this at node label "pwm_led3" in /pwmleds.
 */
#define PWM_DK_LED_NODE DT_NODELABEL(pwm_led3)

#if DT_NODE_HAS_STATUS(PWM_DK_LED_NODE, okay)
static const struct pwm_dt_spec led_pwm = PWM_DT_SPEC_GET(PWM_DK_LED_NODE);
#else
#error "Choose supported PWM driver"
#endif

/* Led PWM period, calculated for 100 Hz signal - in microseconds. */
#define LED_PWM_PERIOD_US (USEC_PER_SEC / 100U)

#ifndef ZB_ROUTER_ROLE
#error Define ZB_ROUTER_ROLE to compile router source code.
#endif

/* Button to start Factory Reset */
#define FACTORY_RESET_BUTTON IDENTIFY_MODE_BUTTON

#if IS_ENABLED(CONFIG_CHIP)
LOG_MODULE_REGISTER(app, CONFIG_CHIP_APP_LOG_LEVEL);
#else
LOG_MODULE_REGISTER(app, LOG_LEVEL_INF);
#endif

/* Main application customizable context.
 * Stores all settings and static values.
 */
typedef struct {
  zb_zcl_basic_attrs_ext_t basic_attr;
  zb_zcl_identify_attrs_t identify_attr;
  zb_zcl_scenes_attrs_t scenes_attr;
  zb_zcl_groups_attrs_t groups_attr;
  zb_zcl_on_off_attrs_t on_off_attr;
  zb_zcl_level_control_attrs_t level_control_attr;
} bulb_device_ctx_t;

/* Zigbee device application context storage. */
static bulb_device_ctx_t dev_ctx;

ZB_ZCL_DECLARE_IDENTIFY_ATTRIB_LIST(identify_attr_list,
                                    &dev_ctx.identify_attr.identify_time);

ZB_ZCL_DECLARE_GROUPS_ATTRIB_LIST(groups_attr_list,
                                  &dev_ctx.groups_attr.name_support);

ZB_ZCL_DECLARE_SCENES_ATTRIB_LIST(scenes_attr_list,
                                  &dev_ctx.scenes_attr.scene_count,
                                  &dev_ctx.scenes_attr.current_scene,
                                  &dev_ctx.scenes_attr.current_group,
                                  &dev_ctx.scenes_attr.scene_valid,
                                  &dev_ctx.scenes_attr.name_support);

ZB_ZCL_DECLARE_BASIC_ATTRIB_LIST_EXT(
    basic_attr_list, &dev_ctx.basic_attr.zcl_version,
    &dev_ctx.basic_attr.app_version, &dev_ctx.basic_attr.stack_version,
    &dev_ctx.basic_attr.hw_version, dev_ctx.basic_attr.mf_name,
    dev_ctx.basic_attr.model_id, dev_ctx.basic_attr.date_code,
    &dev_ctx.basic_attr.power_source, dev_ctx.basic_attr.location_id,
    &dev_ctx.basic_attr.ph_env, dev_ctx.basic_attr.sw_ver);

/* On/Off cluster attributes additions data */
ZB_ZCL_DECLARE_ON_OFF_ATTRIB_LIST(on_off_attr_list,
                                  &dev_ctx.on_off_attr.on_off);

ZB_ZCL_DECLARE_LEVEL_CONTROL_ATTRIB_LIST(
    level_control_attr_list, &dev_ctx.level_control_attr.current_level,
    &dev_ctx.level_control_attr.remaining_time);

ZB_DECLARE_DIMMABLE_LIGHT_CLUSTER_LIST(dimmable_light_clusters, basic_attr_list,
                                       identify_attr_list, groups_attr_list,
                                       scenes_attr_list, on_off_attr_list,
                                       level_control_attr_list);

ZB_DECLARE_DIMMABLE_LIGHT_EP(dimmable_light_ep, DIMMABLE_LIGHT_ENDPOINT,
                             dimmable_light_clusters);

ZBOSS_DECLARE_DEVICE_CTX_1_EP(dimmable_light_ctx, dimmable_light_ep);

/**@brief Starts identifying the device.
 *
 * @param  bufid  Unused parameter, required by ZBOSS scheduler API.
 */
static void start_identifying(zb_bufid_t bufid) {
  ZVUNUSED(bufid);

  if (ZB_JOINED()) {
    /* Check if endpoint is in identifying mode,
     * if not, put desired endpoint in identifying mode.
     */
    if (dev_ctx.identify_attr.identify_time ==
        ZB_ZCL_IDENTIFY_IDENTIFY_TIME_DEFAULT_VALUE) {

      zb_ret_t zb_err_code =
          zb_bdb_finding_binding_target(DIMMABLE_LIGHT_ENDPOINT);

      if (zb_err_code == RET_OK) {
        LOG_INF("Enter identify mode");
      } else if (zb_err_code == RET_INVALID_STATE) {
        LOG_WRN("RET_INVALID_STATE - Cannot enter identify mode");
      } else {
        ZB_ERROR_CHECK(zb_err_code);
      }
    } else {
      LOG_INF("Cancel identify mode");
      zb_bdb_finding_binding_target_cancel();
    }
  } else {
    LOG_WRN("Device not in a network - cannot enter identify mode");
  }
}

/**@brief Implementation of button event handling for the Zigbee bulb.
 *
 * In combined Matter+Zigbee builds the handler returns early when Matter is
 * the active protocol so Matter's own handlers (registered by Board::Init())
 * keep full ownership of the buttons.
 */
static void zb_button_handler_impl(uint32_t button_state, uint32_t has_changed) {
#ifdef CONFIG_ZIGBEE_MATTER_COEXISTENCE
#ifdef CONFIG_ZIGBEE_MATTER_COEXISTENCE_BUTTON_SWITCH
  (void)zigbee_matter_coexistence_process_switch_button(
      button_state, has_changed, PROTOCOL_SWITCH_BUTTON);
#endif

  if (!protocol_is_zigbee_active()) {
    return;
  }
#endif

  if (IDENTIFY_MODE_BUTTON & has_changed) {
    if (IDENTIFY_MODE_BUTTON & button_state) {
      /* Button changed its state to pressed */
    } else {
      /* Button changed its state to released */
      if (was_factory_reset_done()) {
        /* The long press was for Factory Reset */
        LOG_DBG("After Factory Reset - ignore button release");
      } else {
        /* Button released before Factory Reset */

        /* Start identification mode */
        ZB_SCHEDULE_APP_CALLBACK(start_identifying, 0);
      }
    }
  }

  check_factory_reset_button(button_state, has_changed);
}

#ifdef CONFIG_ZIGBEE_MATTER_COEXISTENCE
extern "C" void zb_button_handler(uint32_t button_state, uint32_t has_changed) {
  zb_button_handler_impl(button_state, has_changed);
}

extern "C" void zb_register_button_handler(void) {
  static struct button_handler handler = {
      .cb = zb_button_handler,
  };

  dk_button_handler_add(&handler);
}
#else
/**@brief Callback wrapper for button events (Zigbee-only builds). */
static void button_changed(uint32_t button_state, uint32_t has_changed) {
  zb_button_handler_impl(button_state, has_changed);
}

/**@brief Function for initializing additional PWM leds. */
static void pwm_led_init(void) {
  if (!device_is_ready(led_pwm.dev)) {
    LOG_ERR("Error: PWM device %s is not ready", led_pwm.dev->name);
  }
}

/**@brief Function for initializing LEDs and Buttons. */
static void configure_gpio(void) {
  int err;

  err = dk_buttons_init(button_changed);
  if (err) {
    LOG_ERR("Cannot init buttons (err: %d)", err);
  }

  err = dk_leds_init();
  if (err) {
    LOG_ERR("Cannot init LEDs (err: %d)", err);
  }

  pwm_led_init();
}
#endif /* CONFIG_ZIGBEE_MATTER_COEXISTENCE */

/**@brief Sets brightness of bulb luminous executive element
 *
 * @param[in] brightness_level Brightness level, allowed values 0 ... 255,
 *                             0 - turn off, 255 - full brightness.
 */
static void light_bulb_set_brightness(zb_uint8_t brightness_level) {
  uint32_t pulse = brightness_level * LED_PWM_PERIOD_US / 255U;

  if (pwm_set_dt(&led_pwm, PWM_USEC(LED_PWM_PERIOD_US), PWM_USEC(pulse))) {
    LOG_ERR("Pwm led 4 set fails:\n");
    return;
  }
}

/**@brief Function for setting the light bulb brightness.
 *
 * @param[in] new_level   Light bulb brightness value.
 */
static void level_control_set_value(zb_uint16_t new_level) {
  LOG_INF("Set level value: %i", new_level);

  ZB_ZCL_SET_ATTRIBUTE(DIMMABLE_LIGHT_ENDPOINT, ZB_ZCL_CLUSTER_ID_LEVEL_CONTROL,
                       ZB_ZCL_CLUSTER_SERVER_ROLE,
                       ZB_ZCL_ATTR_LEVEL_CONTROL_CURRENT_LEVEL_ID,
                       (zb_uint8_t *)&new_level, ZB_FALSE);

  light_bulb_set_brightness(new_level);
}

/**@brief Function for turning ON/OFF the light bulb.
 *
 * @param[in]   on   Boolean light bulb state.
 */
static void on_off_set_value(zb_bool_t on) {
  LOG_INF("Set ON/OFF value: %i", on);

  ZB_ZCL_SET_ATTRIBUTE(DIMMABLE_LIGHT_ENDPOINT, ZB_ZCL_CLUSTER_ID_ON_OFF,
                       ZB_ZCL_CLUSTER_SERVER_ROLE, ZB_ZCL_ATTR_ON_OFF_ON_OFF_ID,
                       (zb_uint8_t *)&on, ZB_FALSE);

  if (on) {
    light_bulb_set_brightness(dev_ctx.level_control_attr.current_level);
  } else {
    light_bulb_set_brightness(0U);
  }
}

/**@brief Function to toggle the identify LED - BULB_LED is used for this.
 *
 * @param  bufid  Unused parameter, required by ZBOSS scheduler API.
 */
static void toggle_identify_led(zb_bufid_t bufid) {
  static int blink_status;

  light_bulb_set_brightness(((++blink_status) % 2) ? (255U) : (0U));
  ZB_SCHEDULE_APP_ALARM(toggle_identify_led, bufid,
                        ZB_MILLISECONDS_TO_BEACON_INTERVAL(100));
}

/**@brief Function to handle identify notification events on the first endpoint.
 *
 * @param  bufid  Unused parameter, required by ZBOSS scheduler API.
 */
static void identify_cb(zb_bufid_t bufid) {
  zb_ret_t zb_err_code;

  if (bufid) {
    /* Schedule a self-scheduling function that will toggle the LED. */
    ZB_SCHEDULE_APP_CALLBACK(toggle_identify_led, bufid);
  } else {
    /* Cancel the toggling function alarm and restore current Zigbee LED state.
     */
    zb_err_code =
        ZB_SCHEDULE_APP_ALARM_CANCEL(toggle_identify_led, ZB_ALARM_ANY_PARAM);
    ZVUNUSED(zb_err_code);

    if (dev_ctx.on_off_attr.on_off) {
      light_bulb_set_brightness(dev_ctx.level_control_attr.current_level);
    } else {
      light_bulb_set_brightness(0U);
    }
  }
}

/**@brief Function for initializing all clusters attributes.
 */
static void bulb_clusters_attr_init(void) {
  /* Basic cluster attributes data */
  dev_ctx.basic_attr.zcl_version = ZB_ZCL_VERSION;
  dev_ctx.basic_attr.app_version = BULB_INIT_BASIC_APP_VERSION;
  dev_ctx.basic_attr.stack_version = BULB_INIT_BASIC_STACK_VERSION;
  dev_ctx.basic_attr.hw_version = BULB_INIT_BASIC_HW_VERSION;

  /* Use ZB_ZCL_SET_STRING_VAL to set strings, because the first byte
   * should contain string length without trailing zero.
   *
   * For example "test" string will be encoded as:
   *   [(0x4), 't', 'e', 's', 't']
   */
  ZB_ZCL_SET_STRING_VAL(dev_ctx.basic_attr.mf_name, BULB_INIT_BASIC_MANUF_NAME,
                        ZB_ZCL_STRING_CONST_SIZE(BULB_INIT_BASIC_MANUF_NAME));

  ZB_ZCL_SET_STRING_VAL(dev_ctx.basic_attr.model_id, BULB_INIT_BASIC_MODEL_ID,
                        ZB_ZCL_STRING_CONST_SIZE(BULB_INIT_BASIC_MODEL_ID));

  ZB_ZCL_SET_STRING_VAL(dev_ctx.basic_attr.date_code, BULB_INIT_BASIC_DATE_CODE,
                        ZB_ZCL_STRING_CONST_SIZE(BULB_INIT_BASIC_DATE_CODE));

  dev_ctx.basic_attr.power_source = BULB_INIT_BASIC_POWER_SOURCE;

  ZB_ZCL_SET_STRING_VAL(
      dev_ctx.basic_attr.location_id, BULB_INIT_BASIC_LOCATION_DESC,
      ZB_ZCL_STRING_CONST_SIZE(BULB_INIT_BASIC_LOCATION_DESC));

  dev_ctx.basic_attr.ph_env = BULB_INIT_BASIC_PH_ENV;

  /* Identify cluster attributes data. */
  dev_ctx.identify_attr.identify_time =
      ZB_ZCL_IDENTIFY_IDENTIFY_TIME_DEFAULT_VALUE;

  /* On/Off cluster attributes data. */
  dev_ctx.on_off_attr.on_off = (zb_bool_t)ZB_ZCL_ON_OFF_IS_ON;

  dev_ctx.level_control_attr.current_level =
      ZB_ZCL_LEVEL_CONTROL_LEVEL_MAX_VALUE;
  dev_ctx.level_control_attr.remaining_time =
      ZB_ZCL_LEVEL_CONTROL_REMAINING_TIME_DEFAULT_VALUE;

  ZB_ZCL_SET_ATTRIBUTE(DIMMABLE_LIGHT_ENDPOINT, ZB_ZCL_CLUSTER_ID_ON_OFF,
                       ZB_ZCL_CLUSTER_SERVER_ROLE, ZB_ZCL_ATTR_ON_OFF_ON_OFF_ID,
                       (zb_uint8_t *)&dev_ctx.on_off_attr.on_off, ZB_FALSE);

  ZB_ZCL_SET_ATTRIBUTE(
      DIMMABLE_LIGHT_ENDPOINT, ZB_ZCL_CLUSTER_ID_LEVEL_CONTROL,
      ZB_ZCL_CLUSTER_SERVER_ROLE, ZB_ZCL_ATTR_LEVEL_CONTROL_CURRENT_LEVEL_ID,
      (zb_uint8_t *)&dev_ctx.level_control_attr.current_level, ZB_FALSE);
}

/**@brief Callback function for handling ZCL commands.
 *
 * @param[in]   bufid   Reference to Zigbee stack buffer
 *                      used to pass received data.
 */
static void zcl_device_cb(zb_bufid_t bufid) {
  zb_uint8_t cluster_id;
  zb_uint8_t attr_id;
  zb_zcl_device_callback_param_t *device_cb_param =
      ZB_BUF_GET_PARAM(bufid, zb_zcl_device_callback_param_t);

  LOG_INF("%s id %hd", __func__, device_cb_param->device_cb_id);

  /* Set default response value. */
  device_cb_param->status = RET_OK;

  switch (device_cb_param->device_cb_id) {
  case ZB_ZCL_LEVEL_CONTROL_SET_VALUE_CB_ID:
    LOG_INF("Level control setting to %d",
            device_cb_param->cb_param.level_control_set_value_param.new_value);
    level_control_set_value(
        device_cb_param->cb_param.level_control_set_value_param.new_value);
    break;

  case ZB_ZCL_SET_ATTR_VALUE_CB_ID:
    cluster_id = device_cb_param->cb_param.set_attr_value_param.cluster_id;
    attr_id = device_cb_param->cb_param.set_attr_value_param.attr_id;

    if (cluster_id == ZB_ZCL_CLUSTER_ID_ON_OFF) {
      uint8_t value =
          device_cb_param->cb_param.set_attr_value_param.values.data8;

      LOG_INF("on/off attribute setting to %hd", value);
      if (attr_id == ZB_ZCL_ATTR_ON_OFF_ON_OFF_ID) {
        on_off_set_value((zb_bool_t)value);
      }
    } else if (cluster_id == ZB_ZCL_CLUSTER_ID_LEVEL_CONTROL) {
      uint16_t value =
          device_cb_param->cb_param.set_attr_value_param.values.data16;

      LOG_INF("level control attribute setting to %hd", value);
      if (attr_id == ZB_ZCL_ATTR_LEVEL_CONTROL_CURRENT_LEVEL_ID) {
        level_control_set_value(value);
      }
    } else {
      /* Other clusters can be processed here */
      LOG_INF("Unhandled cluster attribute id: %d", cluster_id);
      device_cb_param->status = RET_NOT_IMPLEMENTED;
    }
    break;

  default:
#ifdef CONFIG_ZIGBEE_SCENES
    if (zcl_scenes_cb(bufid) == ZB_FALSE) {
      device_cb_param->status = RET_NOT_IMPLEMENTED;
    }
#else
    device_cb_param->status = RET_NOT_IMPLEMENTED;
#endif
    break;
  }

  LOG_INF("%s status: %hd", __func__, device_cb_param->status);
}

/**@brief Zigbee stack event handler.
 *
 * @param[in]   bufid   Reference to the Zigbee stack buffer
 *                      used to pass signal.
 */
void zboss_signal_handler(zb_bufid_t bufid) {
  /* Update network status LED. */
  zigbee_led_status_update(bufid, ZIGBEE_NETWORK_STATE_LED);

#if defined(CONFIG_ZIGBEE_TOUCHLINK_TARGET)
  zigbee_touchlink_target_signal_handler(bufid);
#endif

  ZB_ERROR_CHECK(zigbee_default_signal_handler(bufid));

  /* All callbacks should either reuse or free passed buffers.
   * If bufid == 0, the buffer is invalid (not passed).
   */
  if (bufid) {
    zb_buf_free(bufid);
  }
}

extern "C" int ZigbeeStart(void) {
  int blink_status = 0;
#ifdef CONFIG_ZIGBEE_SCENES
  int err;
#endif

  LOG_INF("Starting Zigbee R23 Light Bulb example");

  /* Initialize Buttons and Leds only if not using Matter */
#ifndef CONFIG_ZIGBEE_MATTER_COEXISTENCE
  configure_gpio();
#ifdef CONFIG_ZIGBEE_SCENES
  err = settings_subsys_init();
  if (err) {
    LOG_ERR("settings initialization failed");
  }
#endif
  register_factory_reset_button(FACTORY_RESET_BUTTON);

#endif /* CONFIG_ZIGBEE_MATTER_COEXISTENCE */

  /* Register callback for handling ZCL commands. */
  ZB_ZCL_REGISTER_DEVICE_CB(zcl_device_cb);

  /* Register dimmer switch device context (endpoints). */
  ZB_AF_REGISTER_DEVICE_CTX(&dimmable_light_ctx);

  bulb_clusters_attr_init();
  level_control_set_value(dev_ctx.level_control_attr.current_level);

  /* Register handler to identify notifications. */
  ZB_AF_SET_IDENTIFY_NOTIFICATION_HANDLER(DIMMABLE_LIGHT_ENDPOINT, identify_cb);

#ifdef CONFIG_ZIGBEE_SCENES
  /* Initialize ZCL scene table */
  zcl_scenes_init();

  /* Settings should be loaded after zcl_scenes_init */
  err = settings_load();
  if (err) {
    LOG_ERR("settings loading failed");
  }
#endif

  /* Start Zigbee default thread */
  zigbee_enable();

  LOG_INF("Zigbee R23 Light Bulb example started");

  while (1) {
    dk_set_led(RUN_STATUS_LED, (++blink_status) % 2);
    k_sleep(K_MSEC(RUN_LED_BLINK_INTERVAL));
  }

  return 0;
}
```
