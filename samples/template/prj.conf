## CMakeLists.txt
```
#
# Copyright (c) 2024 Nordic Semiconductor ASA
#
# SPDX-License-Identifier: LicenseRef-Nordic-5-Clause
#

cmake_minimum_required(VERSION 3.20.0)

find_package(Zephyr REQUIRED HINTS $ENV{ZEPHYR_BASE})

project("Zigbee+Matter dual protocol template")

# ============================================================================
# Application Sources and Includes
# ============================================================================

target_include_directories(app PRIVATE
    include
    src
)

target_sources(app PRIVATE
    src/main.c
    src/app_task.cpp
    src/app_task_c.cpp
)

# ============================================================================
# Matter Configuration
# ============================================================================

# Fix mbedTLS API compatibility for NCS 3.1.0's mbedTLS 3.6.4
zephyr_compile_definitions(MBEDTLS_DEPRECATED_REMOVED=1)

# Enable GNU STD support for Matter
include(${ZEPHYR_CONNECTEDHOMEIP_MODULE_DIR}/config/nrfconnect/app/enable-gnu-std.cmake)

# Matter Data Model
include(${ZEPHYR_CONNECTEDHOMEIP_MODULE_DIR}/src/app/chip_data_model.cmake)
include(${ZEPHYR_NRF_MODULE_DIR}/samples/matter/common/cmake/data_model.cmake)

# Matter Common Sources
include(${ZEPHYR_NRF_MODULE_DIR}/samples/matter/common/cmake/source_common.cmake)

# ZAP Configuration
include(${ZEPHYR_NRF_MODULE_DIR}/samples/matter/common/cmake/zap_helpers.cmake)
ncs_get_zap_parent_dir(ZAP_PARENT_DIR)
target_include_directories(app PRIVATE ${ZAP_PARENT_DIR})

# Generate Matter data model
ncs_configure_data_model()
```

## Kconfig
```
#
# Copyright (c) 2024 Nordic Semiconductor ASA
#
# SPDX-License-Identifier: LicenseRef-Nordic-5-Clause
#

# Source base Zephyr Kconfig first
source "Kconfig.zephyr"

# Source the nRF Matter common Kconfig if Matter is enabled
source "$(ZEPHYR_NRF_MODULE_DIR)/samples/matter/common/src/Kconfig"

# Source Matter features Kconfig for CONFIG_CHIP_LAST_FABRIC_REMOVED_* options
rsource "$(ZEPHYR_CONNECTEDHOMEIP_MODULE_DIR)/config/nrfconnect/chip-module/Kconfig.features"
```

## sample.yaml
```
sample:
  description: Zigbee application template
  name: Zigbee application template
common:
  tags:
    - ci_build
    - smoke
    - sysbuild
    - ci_samples_zigbee
tests:
  sample.zigbee.template:
    sysbuild: true
    build_only: true
    integration_platforms:
      - nrf54l15dk/nrf54l10/cpuapp
      - nrf54lm20dk/nrf54lm20a/cpuapp
    platform_allow:
      - nrf52840dk/nrf52840
      - nrf5340dk/nrf5340/cpuapp
      - nrf54l15dk/nrf54l10/cpuapp
      - nrf54l15dk/nrf54l15/cpuapp
      - nrf54lc10dk/nrf54lc10a/cpuapp
      - nrf54lm20dk/nrf54lm20a/cpuapp
      - nrf54lm20dk/nrf54lm20b/cpuapp
```

## sysbuild.conf
```
#
# Copyright (c) 2025 Nordic Semiconductor ASA
#
# SPDX-License-Identifier: LicenseRef-Nordic-5-Clause
#

# Enable Matter support in sysbuild
SB_CONFIG_MATTER=y

# Disable OTA for simpler partitioning
SB_CONFIG_MATTER_OTA=n
SB_CONFIG_BOOTLOADER_MCUBOOT=n
```

## prj.conf
```kconfig
#
# Copyright (c) 2024 Nordic Semiconductor ASA
#
# SPDX-License-Identifier: LicenseRef-Nordic-5-Clause
#

CONFIG_NCS_APPLICATION_BOOT_BANNER_STRING="Zigbee R23 Template"

CONFIG_NCS_SAMPLES_DEFAULTS=y

CONFIG_UART_INTERRUPT_DRIVEN=y
CONFIG_SERIAL=y
CONFIG_GPIO=y

# Make sure printk is not printing to the UART console
CONFIG_CONSOLE=y
CONFIG_UART_CONSOLE=y

CONFIG_HEAP_MEM_POOL_SIZE=2048
CONFIG_MAIN_THREAD_PRIORITY=7

CONFIG_ZIGBEE_ADD_ON=y
CONFIG_ZIGBEE_APP_UTILS=y
CONFIG_ZIGBEE_ROLE_ROUTER=y

# Enable DK LED and Buttons library
CONFIG_DK_LIBRARY=y

# This example requires more workqueue stack
CONFIG_ZBOSS_DEFAULT_THREAD_STACK_SIZE=2944
CONFIG_MAIN_STACK_SIZE=1280
CONFIG_SYSTEM_WORKQUEUE_STACK_SIZE=2048
```

## src/main.c
```c
/*
 * Copyright (c) 2024 Nordic Semiconductor ASA
 *
 * SPDX-License-Identifier: LicenseRef-Nordic-5-Clause
 */

/** @file
 *
 * @brief Zigbee application template.
 */

#include <zephyr/kernel.h>
#include <zephyr/logging/log.h>
#include <dk_buttons_and_leds.h>

#include <zboss_api.h>
#include <zigbee/zigbee_error_handler.h>
#include <zigbee/zigbee_app_utils.h>
#include <zb_nrf_platform.h>
#include "zb_range_extender.h"
#include "app_task_c.h"


/* Device endpoint, used to receive ZCL commands. */
#define APP_TEMPLATE_ENDPOINT               10

/* Type of power sources available for the device.
 * For possible values see section 3.2.2.2.8 of ZCL specification.
 */
#define TEMPLATE_INIT_BASIC_POWER_SOURCE    ZB_ZCL_BASIC_POWER_SOURCE_DC_SOURCE

/* LED indicating that device successfully joined Zigbee network. */
#define ZIGBEE_NETWORK_STATE_LED            DK_LED3

/* LED used for device identification. */
#define IDENTIFY_LED                        DK_LED4

/* Button used to enter the Identify mode. */
#define IDENTIFY_MODE_BUTTON                DK_BTN4_MSK

/* Button to start Factory Reset */
#define FACTORY_RESET_BUTTON                IDENTIFY_MODE_BUTTON

LOG_MODULE_REGISTER(app, LOG_LEVEL_INF);

/* Main application customizable context.
 * Stores all settings and static values.
 */
struct zb_device_ctx {
	zb_zcl_basic_attrs_t basic_attr;
	zb_zcl_identify_attrs_t identify_attr;
};

/* Zigbee device application context storage. */
static struct zb_device_ctx dev_ctx;

ZB_ZCL_DECLARE_IDENTIFY_ATTRIB_LIST(
	identify_attr_list,
	&dev_ctx.identify_attr.identify_time);

ZB_ZCL_DECLARE_BASIC_ATTRIB_LIST(
	basic_attr_list,
	&dev_ctx.basic_attr.zcl_version,
	&dev_ctx.basic_attr.power_source);

ZB_DECLARE_RANGE_EXTENDER_CLUSTER_LIST(
	app_template_clusters,
	basic_attr_list,
	identify_attr_list);

ZB_DECLARE_RANGE_EXTENDER_EP(
	app_template_ep,
	APP_TEMPLATE_ENDPOINT,
	app_template_clusters);

ZBOSS_DECLARE_DEVICE_CTX_1_EP(
	app_template_ctx,
	app_template_ep);


/**@brief Function for initializing all clusters attributes. */
static void app_clusters_attr_init(void)
{
	/* Basic cluster attributes data */
	dev_ctx.basic_attr.zcl_version = ZB_ZCL_VERSION;
	dev_ctx.basic_attr.power_source = TEMPLATE_INIT_BASIC_POWER_SOURCE;

	/* Identify cluster attributes data. */
	dev_ctx.identify_attr.identify_time =
		ZB_ZCL_IDENTIFY_IDENTIFY_TIME_DEFAULT_VALUE;
}

/**@brief Function to toggle the identify LED
 *
 * @param  bufid  Unused parameter, required by ZBOSS scheduler API.
 */
static void toggle_identify_led(zb_bufid_t bufid)
{
	static int blink_status;

	dk_set_led(IDENTIFY_LED, (++blink_status) % 2);
	ZB_SCHEDULE_APP_ALARM(toggle_identify_led, bufid, ZB_MILLISECONDS_TO_BEACON_INTERVAL(100));
}

/**@brief Function to handle identify notification events on the first endpoint.
 *
 * @param  bufid  Unused parameter, required by ZBOSS scheduler API.
 */
static void identify_cb(zb_bufid_t bufid)
{
	zb_ret_t zb_err_code;

	if (bufid) {
		/* Schedule a self-scheduling function that will toggle the LED */
		ZB_SCHEDULE_APP_CALLBACK(toggle_identify_led, bufid);
	} else {
		/* Cancel the toggling function alarm and turn off LED */
		zb_err_code = ZB_SCHEDULE_APP_ALARM_CANCEL(toggle_identify_led, ZB_ALARM_ANY_PARAM);
		ZVUNUSED(zb_err_code);

		dk_set_led(IDENTIFY_LED, 0);
	}
}

/**@brief Starts identifying the device.
 *
 * @param  bufid  Unused parameter, required by ZBOSS scheduler API.
 */
static void start_identifying(zb_bufid_t bufid)
{
	ZVUNUSED(bufid);

	if (ZB_JOINED()) {
		/* Check if endpoint is in identifying mode,
		 * if not put desired endpoint in identifying mode.
		 */
		if (dev_ctx.identify_attr.identify_time ==
		ZB_ZCL_IDENTIFY_IDENTIFY_TIME_DEFAULT_VALUE) {

			zb_ret_t zb_err_code = zb_bdb_finding_binding_target(
				APP_TEMPLATE_ENDPOINT);

			if (zb_err_code == RET_OK) {
				LOG_INF("Enter identify mode");
			} else if (zb_err_code == RET_INVALID_STATE) {
				LOG_WRN("RET_INVALID_STATE - Cannot enter identify mode");
			} else {
				ZB_ERROR_CHECK(zb_err_code);
			}
		} else {
			LOG_INF("Cancel identify mode");
			zb_bdb_finding_binding_target_cancel();
		}
	} else {
		LOG_WRN("Device not in a network - cannot enter identify mode");
	}
}

/**@brief Callback for button events.
 *
 * @param[in]   button_state  Bitmask containing buttons state.
 * @param[in]   has_changed   Bitmask containing buttons
 *                            that have changed their state.
 */
static void button_changed(uint32_t button_state, uint32_t has_changed)
{
	if (IDENTIFY_MODE_BUTTON & has_changed) {
		if (IDENTIFY_MODE_BUTTON & button_state) {
			/* Button changed its state to pressed */
		} else {
			/* Button changed its state to released */
			if (was_factory_reset_done()) {
				/* The long press was for Factory Reset */
				LOG_DBG("After Factory Reset - ignore button release");
			} else   {
				/* Button released before Factory Reset */

				/* Start identification mode */
				ZB_SCHEDULE_APP_CALLBACK(start_identifying, 0);
			}
		}
	}

	check_factory_reset_button(button_state, has_changed);
}

/**@brief Function for initializing LEDs and Buttons. */
static void configure_gpio(void)
{
	int err;

	err = dk_buttons_init(button_changed);
	if (err) {
		LOG_ERR("Cannot init buttons (err: %d)", err);
	}

	err = dk_leds_init();
	if (err) {
		LOG_ERR("Cannot init LEDs (err: %d)", err);
	}
}

/**@brief Zigbee stack event handler.
 *
 * @param[in]   bufid   Reference to the Zigbee stack buffer
 *                      used to pass signal.
 */
void zboss_signal_handler(zb_bufid_t bufid)
{
	/* Update network status LED. */
	zigbee_led_status_update(bufid, ZIGBEE_NETWORK_STATE_LED);

	/* No application-specific behavior is required.
	 * Call default signal handler.
	 */
	ZB_ERROR_CHECK(zigbee_default_signal_handler(bufid));

	/* All callbacks should either reuse or free passed buffers.
	 * If bufid == 0, the buffer is invalid (not passed).
	 */
	if (bufid) {
		zb_buf_free(bufid);
	}
}

int main(void)
{
	LOG_INF("Starting Zigbee R23 application template example");

	/* Initialize */
	configure_gpio();
	register_factory_reset_button(FACTORY_RESET_BUTTON);

	/* Register device context (endpoints). */
	ZB_AF_REGISTER_DEVICE_CTX(&app_template_ctx);

	app_clusters_attr_init();

	/* Register handlers to identify notifications */
	ZB_AF_SET_IDENTIFY_NOTIFICATION_HANDLER(APP_TEMPLATE_ENDPOINT, identify_cb);

	/* Start Zigbee default thread */
	zigbee_enable();

	LOG_INF("Zigbee R23 application template started");

	/* Start the dual protocol application task */
        app_task_start();	return 0;
}
```

## src/app_task.cpp
```c
/*
 * Copyright (c) 2021 Nordic Semiconductor ASA
 *
 * SPDX-License-Identifier: LicenseRef-Nordic-5-Clause
 */

#include "app_task.h"

#include <zephyr/kernel.h>
#include <zephyr/logging/log.h>

#ifdef CONFIG_CHIP
#include "app/matter_init.h"
#include "app/task_executor.h"
#include "board/board.h"
#include "lib/core/CHIPError.h"
#include "lib/support/CodeUtils.h"
#include <setup_payload/OnboardingCodesUtil.h>
#endif

#ifdef CONFIG_CHIP
LOG_MODULE_DECLARE(app, CONFIG_CHIP_APP_LOG_LEVEL);
#else
LOG_MODULE_REGISTER(app, LOG_LEVEL_INF);
#endif

#ifdef CONFIG_CHIP
using namespace ::chip;
using namespace ::chip::app;
using namespace ::chip::DeviceLayer;

CHIP_ERROR AppTask::Init()
{
	/* Initialize Matter stack */
	ReturnErrorOnFailure(Nrf::Matter::PrepareServer());

	if (!Nrf::GetBoard().Init()) {
		LOG_ERR("User interface initialization failed.");
		return CHIP_ERROR_INCORRECT_STATE;
	}

	/* Register Matter event handler that controls the connectivity status LED based on the captured Matter network
	 * state. */
	ReturnErrorOnFailure(Nrf::Matter::RegisterEventHandler(Nrf::Board::DefaultMatterEventHandler, 0));

	return Nrf::Matter::StartServer();
}

CHIP_ERROR AppTask::StartApp()
{
	ReturnErrorOnFailure(Init());

	while (true) {
		Nrf::DispatchNextTask();
	}

	return CHIP_NO_ERROR;
}

#else
// Non-Matter implementation for Zigbee+Matter dual protocol
int AppTask::Init()
{
	LOG_INF("Initializing Zigbee+Matter dual protocol application");
	return 0;
}

int AppTask::StartApp()
{
	if (Init() != 0) {
		LOG_ERR("Application initialization failed");
		return -1;
	}

	LOG_INF("Zigbee+Matter Template Application started");
	
	while (true) {
		k_sleep(K_MSEC(100));
		// TODO: Add protocol switching logic here
	}
	
	return 0;
}
#endif
```

## src/app_task.h
```c
/*
 * Copyright (c) 2021 Nordic Semiconductor ASA
 *
 * SPDX-License-Identifier: LicenseRef-Nordic-5-Clause
 */

#pragma once

#ifdef CONFIG_CHIP
#include <platform/CHIPDeviceLayer.h>
#endif

struct k_timer;

class AppTask {
public:
	static AppTask &Instance()
	{
		static AppTask sAppTask;
		return sAppTask;
	};

#ifdef CONFIG_CHIP
	CHIP_ERROR StartApp();
private:
	CHIP_ERROR Init();
#else
	int StartApp();
private:
	int Init();
#endif
};
```

## src/app_task_c.cpp
```c
/*
 * Copyright (c) 2021 Nordic Semiconductor ASA
 *
 * SPDX-License-Identifier: LicenseRef-Nordic-5-Clause
 */

#include "app_task_c.h"
#include "app_task.h"

#ifdef CONFIG_CHIP
#include <platform/CHIPDeviceLayer.h>
#endif

int app_task_start(void)
{
#ifdef CONFIG_CHIP
    CHIP_ERROR err = AppTask::Instance().StartApp();
    return (err == CHIP_NO_ERROR) ? 0 : -1;
#else
    return AppTask::Instance().StartApp();
#endif
}
```

## src/app_task_c.h
```c
/*
 * Copyright (c) 2021 Nordic Semiconductor ASA
 *
 * SPDX-License-Identifier: LicenseRef-Nordic-5-Clause
 */

#pragma once

#ifdef __cplusplus
extern "C" {
#endif

/**
 * Start the application task.
 * 
 * @return 0 on success, negative error code on failure
 */
int app_task_start(void);

#ifdef __cplusplus
}
#endif
```

## src/radio_manager.h
```c
/**
 * Radio Manager for Protocol Switching
 * 
 * This module manages the IEEE 802.15.4 radio shared between Zigbee and OpenThread/Matter.
 * Protocols are never active simultaneously - the radio is switched between them.
 * 
 * Protocol State Machine:
 *   ZIGBEE_ACTIVE → (Matter commissioning) → COMMISSIONING → THREAD_ACTIVE
 */

#ifndef RADIO_MANAGER_H
#define RADIO_MANAGER_H

#include <zephyr/kernel.h>

#ifdef __cplusplus
extern "C" {
#endif

/**
 * Protocol states for radio management
 */
typedef enum {
    RADIO_PROTOCOL_NONE = 0,       ///< Radio not initialized
    RADIO_PROTOCOL_ZIGBEE,         ///< Zigbee active on radio
    RADIO_PROTOCOL_COMMISSIONING,  ///< Transitioning (BLE commissioning)
    RADIO_PROTOCOL_THREAD          ///< Thread/Matter active on radio
} radio_protocol_t;

/**
 * Get current active protocol on the radio
 * @return Current protocol state
 */
radio_protocol_t radio_manager_get_active_protocol(void);

/**
 * Initialize radio for Zigbee operation
 * @return 0 on success, negative error code on failure
 */
int radio_manager_start_zigbee(void);

/**
 * Stop Zigbee and prepare for protocol switch
 * @return 0 on success, negative error code on failure
 */
int radio_manager_stop_zigbee(void);

/**
 * Initialize radio for Thread/OpenThread operation
 * @return 0 on success, negative error code on failure
 */
int radio_manager_start_thread(void);

/**
 * Stop Thread and prepare for protocol switch
 * @return 0 on success, negative error code on failure
 */
int radio_manager_stop_thread(void);

#ifdef __cplusplus
}
#endif

#endif /* RADIO_MANAGER_H */
```

## src/zigbee_radio_compat.c
```c
/**
 * Zigbee Radio Driver Compatibility Patch
 * 
 * This file provides wrapper functions for Zigbee radio to avoid symbol
 * conflicts with OpenThread L2 layer during protocol switching.
 * 
 * The Zigbee radio functions have been renamed in zb_nrf_transceiver.c:
 *   - ieee802154_init() → zigbee_ieee802154_init()
 *   - ieee802154_handle_ack() → zigbee_ieee802154_handle_ack()
 * 
 * This file provides weak wrappers that default to Zigbee but can be
 * overridden by the protocol manager for runtime switching.
 */

#include <zephyr/net/net_if.h>
#include <zephyr/net/net_pkt.h>

/* Forward declare the renamed Zigbee implementations */
extern void zigbee_ieee802154_init(struct net_if *iface);
extern enum net_verdict zigbee_ieee802154_handle_ack(struct net_if *iface, struct net_pkt *pkt);

/* Weak wrappers that can be overridden for protocol switching */
__weak void ieee802154_init(struct net_if *iface)
{
    /* Default to Zigbee during startup */
    zigbee_ieee802154_init(iface);
}

__weak enum net_verdict ieee802154_handle_ack(struct net_if *iface, struct net_pkt *pkt)
{
    /* Default to Zigbee during startup */
    return zigbee_ieee802154_handle_ack(iface, pkt);
}
```
